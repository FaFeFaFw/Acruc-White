## CMakeLists.txt
```
# SPDX-License-Identifier: Apache-2.0

cmake_minimum_required(VERSION 3.20.0)
find_package(Zephyr REQUIRED HINTS $ENV{ZEPHYR_BASE})
project(thingy52)

add_subdirectory(mylib)
# add_subdirectory(apps)

zephyr_include_directories(${CMAKE_CURRENT_SOURCE_DIR}/include)

target_sources(app PRIVATE src/main.c)
# target_link_libraries(mylib)

if(IBEACON_RSSI)
  zephyr_compile_definitions(IBEACON_RSSI=${IBEACON_RSSI})
endif()
```

## prj.conf
```kconfig
CONFIG_GPIO=y

CONFIG_BT=y
CONFIG_BT_EXT_ADV=y
CONFIG_BT_PER_ADV=y
CONFIG_LOG=y

###### RTT_CONFIG ######
CONFIG_USE_SEGGER_RTT=y
CONFIG_RTT_CONSOLE=y
CONFIG_UART_CONSOLE=n
########################

CONFIG_STDOUT_CONSOLE=y
CONFIG_I2C=y
CONFIG_SENSOR=y

CONFIG_CBPRINTF_FP_SUPPORT=y

CONFIG_STDOUT_CONSOLE=y
```

## src/main.c
```c
/*
 * Copyright (c) 2018 Henrik Brix Andersen <henrik@brixandersen.dk>
 *
 * SPDX-License-Identifier: Apache-2.0
 */

#include <zephyr/types.h>
#include <stddef.h>
#include <zephyr/sys/printk.h>
#include <zephyr/sys/util.h>
#include <zephyr/bluetooth/bluetooth.h>
#include <zephyr/bluetooth/hci.h>

#include "thingy52_ibeacon.h"
#include "hts221_sensor.h"
#include "lps22hb_sensor.h"
#include "ccs811_sensor.h"

int main(void)
{

	ibeacon_init();
	return 0;
}

K_THREAD_DEFINE(hts221_thread_id, HTS221_THREAD_STACK_SIZE, hts221_thread, NULL, NULL, NULL,
		HTS221_THREAD_PRIORITY, 0, 0);

// K_THREAD_DEFINE(lps22hb_thread_id, LPS22HB_THREAD_STACK_SIZE, lps22hb_thread, NULL, NULL, NULL,
// 		LPS22HB_THREAD_PRIORITY, 0, 0);

K_THREAD_DEFINE(ccs811_thread_id, CCS811_THREAD_STACK_SIZE, ccs811_thread, NULL, NULL, NULL,
		CCS811_THREAD_PRIORITY, 0, 0);
```

## include/ccs811_sensor.h
```c
/**
 ************************************************************
 * @file ccs811_sensor.h
 * @author Fan Yang
 * @date 23/03/2024
 * @brief Ccs811 sensor
 *************************************************************
 */

#ifndef CCS811_SENSOR_H
#define CCS811_SENSOR_H

#include <zephyr/kernel.h>
#include <zephyr/device.h>
#include <zephyr/drivers/sensor.h>
#include <zephyr/sys/printk.h>
#include <zephyr/drivers/sensor/ccs811.h>
#include <stdio.h>

#define CCS811_THREAD_STACK_SIZE 1024
#define CCS811_THREAD_PRIORITY   10

void ccs811_thread(void);

#endif
```

## include/hts221_sensor.h
```c
/**
 ************************************************************
 * @file hts221_sensor.h
 * @author Fan Yang
 * @date 22/03/2024
 * @brief Hts221 sensor, temp and humidity
 *************************************************************
 *
 *************************************************************
 */

#ifndef HTS221_SENSOR_H
#define HTS221_SENSOR_H

#include <zephyr/kernel.h>
#include <zephyr/device.h>
#include <zephyr/drivers/sensor.h>
#include <stdio.h>
#include <zephyr/sys/util.h>
#include <zephyr/sys/printk.h>

#define HTS221_THREAD_STACK_SIZE 1024
#define HTS221_THREAD_PRIORITY   10

// void hts221_sensor_init(void);
uint8_t get_temp(const struct device *dev);
uint8_t get_humidity(const struct device *dev);
void hts221_thread(void);

#endif
```

## include/lps22hb_sensor.h
```c
/**
 ************************************************************
 * @file lps22hb_sensor.h
 * @author Fan Yang
 * @date 23/03/2024
 * @brief LPS22hb sensor, temp and humidity
 *************************************************************
 *
 *************************************************************
 */

#ifndef LPS22HB_SENSOR_H
#define LPS22HB_SENSOR_H

#include <zephyr/kernel.h>
#include <zephyr/device.h>
#include <zephyr/drivers/sensor.h>
#include <stdio.h>
#include <zephyr/sys/util.h>
#include <zephyr/sys/printk.h>

#define LPS22HB_THREAD_STACK_SIZE 1024
#define LPS22HB_THREAD_PRIORITY   10

void process_sample(const struct device *dev);
void lps22hb_thread(void);
void lps22hb_sensor_init(void);

#endif
```

## include/thingy52_ibeacon.h
```c
/**
 ************************************************************
 * @file thingy52_ibeacon.h
 * @author Fan Yang
 * @date 22/03/2024
 * @brief Set iBeacon advertisement data for thingy52
 *************************************************************
 *
 *************************************************************
 */

#ifndef THINGY_IBEACON_H
#define THINGY_IBEACON_H

#include <zephyr/types.h>
#include <stddef.h>
#include <zephyr/sys/printk.h>
#include <zephyr/sys/util.h>

#include <zephyr/bluetooth/bluetooth.h>
#include <zephyr/bluetooth/hci.h>
#include <zephyr/bluetooth/addr.h>

#define IBEACON_THREAD_STACK_SIZE 1024
#define IBEACON_THREAD_PRIORITY   10

void ibeacon_init(void);
void update_ibeacon_major(uint8_t major1, uint8_t major2);
void update_ibeacon_minor1(uint8_t minor1);
void update_ibeacon_minor2(uint8_t minor1);
void update_ibeacon_thread(void);

#endif
```
